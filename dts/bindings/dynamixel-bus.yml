## dts/bindings/dynamixel-bus.yml
```yaml
description: "ITAndroids Dynamixel 1.0/2.0 bus"

compatible: "dynamixel-bus"

include: base.yaml

properties:
  uart:
    type: phandle
    required: true
    description: UART device used for half-duplex communication.
  
  direction-gpios:
    type: phandle-array
    required: true
    description: GPIO for controlling the direction of half-duplex communication (TX enable/disable).

  motor-ids:
    type: array
    required: true
    description: List of motor IDs connected to this UART bus.

  timeout-timer:
    type: phandle
    required: true
    description: Timer peripheral used for specifying sub-tick timeout.

  timeout-timer-channel:
    type: int
    required: true
    description: Channel of timeout-timer.
```

## lib/dynamixel/Kconfig
```kconfig
config DYNAMIXEL
    bool "Enables the Dynamixel library"

    config DYNAMIXEL_MAX_NUM_SERVOS
    int "Maximum number of servos to be addressed at once"
    default 20

    config DYNAMIXEL_MAX_NUM_BYTES
    int "Maximum number of bytes written/read per servo"
    default 4

    choice
        prompt "Select protocol version to be used"
        config DYNAMIXEL_PROTOCOL_1
                tristate "DYNAMIXEL Protocol 1.0"
        config DYNAMIXEL_PROTOCOL_2
                tristate "DYNAMIXEL Protocol 2.0"
                select CRC
    endchoice

    module = DYNAMIXEL
    module-str = dxl
    source "subsys/logging/Kconfig.template.log_config"
```
