## prj.conf
```kconfig
CONFIG_GPIO=y
CONFIG_DYNAMIXEL=y
CONFIG_DYNAMIXEL_PROTOCOL_2=y
CONFIG_DYNAMIXEL_LOG_LEVEL_DBG=y

CONFIG_SERIAL=y
CONFIG_UART_INTERRUPT_DRIVEN=y

CONFIG_LOG=y

CONFIG_RING_BUFFER=y

CONFIG_COUNTER=y
CONFIG_EVENTS=y
```

## boards/native_sim.conf
```kconfig
CONFIG_COUNTER_NATIVE_SIM_FREQUENCY=100000
CONFIG_STACK_SENTINEL=y
CONFIG_THREAD_STACK_INFO=y
CONFIG_LOG_MODE_IMMEDIATE=y
CONFIG_ARCH_POSIX_TRAP_ON_FATAL=y
```

## boards/native_sim.overlay
```dts
/ {
    uart3: uart3 {
        status = "okay";
        compatible = "zephyr,native-tty-uart";
        serial-port = "/tmp/ttyUSB0";
        current-speed = <1000000>;
    };

    dxl0: dxl0 {
        compatible = "dynamixel-bus";
        uart = <&uart3>;
        direction-gpios = <&gpio0 5 1>;
        motor-ids = <1 2 3>;
        timeout-timer = <&counter0>;
        timeout-timer-channel = <0>;
    }; 
};
```

## src/main.c
```c
#include <zephyr/sys/__assert.h>
#include <zephyr/kernel.h>
#include <zephyr/logging/log.h>
#include "dynamixel/bus.h"
#include "dynamixel/instruction_packet.h"

LOG_MODULE_REGISTER(main, CONFIG_SOC_LOG_LEVEL);

const struct device *dxl = DEVICE_DT_GET(DT_NODELABEL(dxl0));

int main()
{
	uint8_t ids[] = {0x01, 0x02};
	uint16_t values[] = {0x00FF, 0x00AA};

	dxl_inst_packet_t inst_packet;
	dxl_err_t status = dxl_make_sync_write_i16(&inst_packet, 0x20, ids, 2, values);
	__ASSERT(status == DXL_OK, "Error composing sync write packet");
	LOG_INF("dxl_make_sync_write_i16 returned %d", status);

	int ret = dynamixel_send_receive(dxl, &inst_packet, NULL, 39000); // 0 packets are expected
	LOG_INF("dynamixel_send_receive status: %d", ret);

	status = dxl_make_sync_read_i16(&inst_packet, 0x20, ids, 2);
	__ASSERT(status == DXL_OK, "Error composing sync write packet");
	LOG_INF("dxl_make_sync_read_i16 returned %d", status);
	dxl_status_packet_t status_packets[2];

	ret = dynamixel_send_receive(dxl, &inst_packet, status_packets, 5000);
	LOG_INF("dynamixel_send_receive status: %d", ret);

	return 0;
}
```
