## CMakeLists.txt
```
cmake_minimum_required(VERSION 3.20.0)

find_package(Zephyr REQUIRED HINTS $ENV{ZEPHYR_BASE})
project(dynamixel_test)
target_sources(
    app PRIVATE src/main.c src/parser.c src/serializer_protocol2.c
)
```

## prj.conf
```kconfig
CONFIG_LOG=y
CONFIG_DYNAMIXEL=y
CONFIG_DYNAMIXEL_PROTOCOL_2=y
CONFIG_DYNAMIXEL_LOG_LEVEL_DBG=y


CONFIG_ZTEST=y
```

## src/main.c
```c
#include <zephyr/ztest.h>

ZTEST_SUITE(dxl_tests, NULL, NULL, NULL, NULL, NULL);
```

## src/parser.c
```c
#include <zephyr/ztest.h>
#include "dynamixel/parser.h"

static const uint8_t status_packet[] = {0xFF, 0xFF, 0xFD, 0x00, 0x01, 0x07, 0x00,
					0x55, 0x00, 0x06, 0x04, 0x26, 0x65, 0x5D};
static const uint8_t status_packet_wrong_crc[] = {0xFF, 0xFF, 0xFD, 0x00, 0x01, 0x07, 0x00,
						  0x55, 0x00, 0x06, 0x04, 0x26, 0x65, 0x5A};
static size_t status_packet_length = sizeof(status_packet) / sizeof(status_packet[0]);

static void test_parser_match_callback(dxl_parser_handle parser, uint8_t *buffer, size_t size,
				       void *arg)
{
	uint8_t *hits = arg;
	(*hits)++;
}

ZTEST(dxl_tests, test_parser)
{
	dxl_err_t err = DXL_OK;
	uint8_t hits = 0;
	dxl_parser_handle parser = dxl_parser_create();
	zassert_true(parser != NULL);

	err = dxl_parser_set_match_callback(parser, test_parser_match_callback);
	zassert_equal(err, 0, "Failed to set callback");
	err = dxl_parser_set_arg(parser, &hits);
	zassert_equal(err, 0, "Failed to add arg to callback");

	// Parser hits when a valid message is incoming
	dxl_parser_feed_bytes(parser, status_packet, status_packet_length);
	zassert_equal(hits, 1, "Match on valid message failed");
	dxl_parser_feed_bytes(parser, status_packet, status_packet_length);
	zassert_equal(hits, 2, "Match on valid message repeat failed");

	// Parser hits with wrong CRC (error detection happens afterwards)
    dxl_parser_feed_bytes(parser, status_packet_wrong_crc, status_packet_length);
	zassert_equal(hits, 3, "Match on message with wrong CRC failed");

    // Parser doesn't hit with incomplete message (which is the second one)
    dxl_parser_feed_bytes(parser, status_packet, status_packet_length - 5);
    dxl_parser_feed_bytes(parser, status_packet, status_packet_length - 3);
    zassert_equal(hits, 4, "Match happened on incomplete message");

    // Parser hits when receiving a message after a reset
    dxl_parser_reset_state(parser);
    dxl_parser_feed_bytes(parser, status_packet, status_packet_length);
	zassert_equal(hits, 5, "Match failed after reset");
}
```

## src/serializer_protocol2.c
```c
#include <zephyr/ztest.h>
#include "dynamixel/serializer.h"

// Ping example, ID1
const uint8_t ping_instruction_packet[] = {0xFF, 0xFF, 0xFD, 0x00, 0x01,
					   0x03, 0x00, 0x01, 0x19, 0x4E};
const size_t ping_instruction_packet_len =
	sizeof(ping_instruction_packet) / sizeof(ping_instruction_packet[0]);

// Read example, ID1(XM430-W210) : Present Position(132, 0x0084, 4[byte]) = 166(0x000000A6)
const uint8_t read_instruction_packet[] = {0xFF, 0xFF, 0xFD, 0x00, 0x01, 0x07, 0x00,
					   0x02, 0x84, 0x00, 0x04, 0x00, 0x1D, 0x15};
const size_t read_instruction_packet_len =
	sizeof(read_instruction_packet) / sizeof(read_instruction_packet[0]);

ZTEST(dxl_tests, test_serializer_protocol2)
{
	const size_t buffer_size = 50;
	uint8_t buffer[buffer_size];
	dxl_inst_packet_t packet;
    size_t written_len;
	int err = 0;

	err = dxl_serialize_instruction_packet(NULL, buffer, buffer_size);
	zassert_equal(err, DXL_PTR_ERROR);
	err = dxl_serialize_instruction_packet(&packet, NULL, buffer_size);
	zassert_equal(err, DXL_PTR_ERROR);
	packet.params_length = UINT16_MAX; // Total length would overflow
	err = dxl_serialize_instruction_packet(&packet, buffer, buffer_size);
	zassert_equal(err, DXL_ERROR);

	// Test ping output
	memset(&packet, 0, sizeof(packet));
	packet.id = 0x01;
	packet.instruction = DXL_INST_PING;
	packet.params_length = 0;
	err = dxl_serialize_instruction_packet(&packet, buffer, ping_instruction_packet_len - 1);
	zassert_equal(err, DXL_ERROR); // Buffer too small
	written_len = dxl_serialize_instruction_packet(&packet, buffer, buffer_size);
	zassert_equal(ping_instruction_packet_len, written_len);
	zassert_mem_equal(buffer, ping_instruction_packet, ping_instruction_packet_len);

	// Test read output
	memset(&packet, 0, sizeof(packet));
	packet.id = 0x01;
	packet.instruction = DXL_INST_READ;
	packet.params_length = 4;
	uint8_t params[] = {0x84, 0x00, 0x04, 0x00};
	memcpy(&(packet.params), params, packet.params_length);
	err = dxl_serialize_instruction_packet(&packet, buffer, read_instruction_packet_len - 1);
	zassert_equal(err, DXL_ERROR); // Buffer too small
	written_len = dxl_serialize_instruction_packet(&packet, buffer, buffer_size);
	zassert_equal(read_instruction_packet_len, written_len);
	zassert_mem_equal(buffer, read_instruction_packet, read_instruction_packet_len);
}
```
